## main/Kconfig
```kconfig
config SKID_MOTOR_PWM_FREQ
    int "PWM frequency for the motors"

config SKID_POWER_PIN
    int "GPIO that must be HIGH at all times"

config SKID_MOTOR_LEFT_A_PIN
    int "GPIO for the left motor A"

config SKID_MOTOR_LEFT_B_PIN
    int "GPIO for the left motor B"

config SKID_MOTOR_RIGHT_A_PIN
    int "GPIO for the right motor A"

config SKID_MOTOR_RIGHT_B_PIN
    int "GPIO for the right motor B"

config SKID_MOTOR_ARM_A_PIN
    int "GPIO for the arm motor A"

config SKID_MOTOR_ARM_B_PIN
    int "GPIO for the arm motor B"

config SKID_SERVO_BUCKET_PIN
    int "GPIO for the bucket servo"

config SKID_SERVO_AUX_PIN
    int "GPIO for the aux servo"

config SKID_SERVO_STEP_MS
    int "Servo step interval in milliseconds"

config SKID_SERVO_BUCKET_MIN_DEG
    int "Bucket servo minimum angle in degrees"
    default 60

config SKID_SERVO_BUCKET_MAX_DEG
    int "Bucket servo maximum angle in degrees"
    default 175

config SKID_SERVO_AUX_MIN_DEG
    int "Aux servo minimum angle in degrees"
    default 5

config SKID_SERVO_AUX_MAX_DEG
    int "Aux servo maximum angle in degrees"
    default 175

config SKID_LEDS_PIN
    int "GPIO for the WS2812 LEDs"

config SKID_STATUS_LED_PIN
    int "Optional GPIO for the status LED"

config SKID_STATUS_LED_VALUE
    int "Value for the status LED when on"
    default 1
```

## sdkconfig.defaults
```kconfig
# Custom partition table
CONFIG_ESPTOOLPY_FLASHSIZE_4MB=y
CONFIG_COMPILER_OPTIMIZATION_PERF=y

# Enable support for power management
CONFIG_PM_ENABLE=y
CONFIG_PM_DFS_INIT_AUTO=y
CONFIG_FREERTOS_USE_TICKLESS_IDLE=y

# Bluetooh related
CONFIG_BT_ENABLED=y
CONFIG_BT_CONTROLLER_ONLY=y
# Enable Dualmode (BLE and BR/EDR)
CONFIG_BTDM_CTRL_MODE_BTDM=y
#CONFIG_BTDM_CTRL_MODE_BR_EDR_ONLY=y
# Should be, at least, one more than CONFIG_BLUEPAD32_MAX_DEVICES
# See: https://gitlab.com/ricardoquesada/bluepad32/-/issues/11
CONFIG_BTDM_CTRL_BR_EDR_MAX_ACL_CONN=5
CONFIG_BTDM_CTRL_BLE_MAX_CONN=5
CONFIG_BTDM_CTRL_BR_EDR_MAX_SYNC_CONN=0
CONFIG_BTDM_CTRL_AUTO_LATENCY=y
CONFIG_BTDM_CTRL_MODEM_SLEEP=n

CONFIG_BLUEPAD32_USB_CONSOLE_ENABLE=n
CONFIG_BLUEPAD32_PLATFORM_UNIJOYSTICLE=n
CONFIG_BLUEPAD32_MAX_DEVICES=4
CONFIG_BLUEPAD32_PLATFORM_CUSTOM=y

# Skid
CONFIG_SKID_MOTOR_PWM_FREQ=100
CONFIG_SKID_POWER_PIN=23
CONFIG_SKID_MOTOR_LEFT_A_PIN=2
CONFIG_SKID_MOTOR_LEFT_B_PIN=4
CONFIG_SKID_MOTOR_RIGHT_A_PIN=22
CONFIG_SKID_MOTOR_RIGHT_B_PIN=12
CONFIG_SKID_MOTOR_ARM_A_PIN=13
CONFIG_SKID_MOTOR_ARM_B_PIN=21
CONFIG_SKID_SERVO_BUCKET_PIN=17
CONFIG_SKID_SERVO_AUX_PIN=5
CONFIG_SKID_LEDS_PIN=18
CONFIG_SKID_SERVO_STEP_MS=100
CONFIG_SKID_STATUS_LED_PIN=0
CONFIG_SKID_STATUS_LED_VALUE=0
```

## skidsteer-firmware/sdkconfig.defaults
```kconfig
# Custom partition table
CONFIG_ESPTOOLPY_FLASHSIZE_4MB=y

# Enable support for power management
CONFIG_PM_ENABLE=y
CONFIG_PM_DFS_INIT_AUTO=y
CONFIG_FREERTOS_USE_TICKLESS_IDLE=y
```
